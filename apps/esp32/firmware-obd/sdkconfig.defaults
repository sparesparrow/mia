## apps/esp32/src/sdkconfig.defaults
```kconfig
# WiFi Configuration
CONFIG_ESP_WIFI_SSID="MIA_NETWORK"
CONFIG_ESP_WIFI_PASSWORD="mia_password"
CONFIG_ESP_WIFI_AUTH_OPEN=n
CONFIG_ESP_WIFI_AUTH_WPA2_PSK=y

# HTTP Client Configuration
CONFIG_ESP_HTTP_CLIENT_ENABLE_BASIC_AUTH=n
CONFIG_ESP_HTTP_CLIENT_ENABLE_DIGEST_AUTH=n

# ADC Configuration
CONFIG_ADC_ONESHOT_MODE_ENABLE=y

# GPIO Configuration
CONFIG_GPIO_CTRL_FUNC_IN_IRAM=y

# Power Management
CONFIG_PM_ENABLE=y

# Logging
CONFIG_LOG_DEFAULT_LEVEL_INFO=y
CONFIG_LOG_MAXIMUM_LEVEL_INFO=y

# MIA-Specific Configuration
CONFIG_MIA_ESP32_DEVICE_ID="esp32_01"
CONFIG_MIA_RPI_HOST="192.168.200.134"
CONFIG_MIA_RPI_PORT=8080
```
